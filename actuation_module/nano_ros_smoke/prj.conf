## CMakeLists.txt
```
# Copyright (c) 2026, NEWSLab NTU.
# SPDX-License-Identifier: Apache-2.0
#
# Phase 1A smoke — minimal nros-cpp Int32 publisher proving the nano-ros
# Zephyr module wires into the ASI build. Adapted from
# nano-ros-autoware/examples/zephyr/cpp/dds/talker/.

cmake_minimum_required(VERSION 3.20.0)

find_package(Zephyr REQUIRED HINTS $ENV{ZEPHYR_BASE})
project(asi_nano_ros_smoke LANGUAGES CXX)

# Backend = dust-dds (CONFIG_NROS_RMW_DDS) — selected in prj.conf.
# Generated C++ bindings come from the nros module's codegen helper.
nros_generate_interfaces(std_msgs LANGUAGE CPP)

target_sources(app PRIVATE src/main.cpp)
```

## prj.conf
```kconfig
# Phase 1A smoke — nros-cpp Int32 publisher
# Backend: dust-dds (RTPS, no router required).

# -----------------------------------------------------------------------------
# General
# -----------------------------------------------------------------------------
CONFIG_MAIN_STACK_SIZE=16384
CONFIG_HEAP_MEM_POOL_SIZE=65536
CONFIG_SYSTEM_WORKQUEUE_STACK_SIZE=4096

# -----------------------------------------------------------------------------
# C++ support
# -----------------------------------------------------------------------------
CONFIG_CPP=y
CONFIG_STD_CPP14=y

# -----------------------------------------------------------------------------
# Logging
# -----------------------------------------------------------------------------
CONFIG_LOG=y
CONFIG_LOG_DEFAULT_LEVEL=3
CONFIG_PRINTK=y
CONFIG_EARLY_CONSOLE=y
CONFIG_LOG_BACKEND_RTT=n

# -----------------------------------------------------------------------------
# Networking
# -----------------------------------------------------------------------------
CONFIG_NETWORKING=y
CONFIG_NET_IPV4=y
CONFIG_NET_TCP=y
CONFIG_NET_UDP=y
CONFIG_NET_SOCKETS=y
CONFIG_NET_PKT_RX_COUNT=32
CONFIG_NET_PKT_TX_COUNT=32
CONFIG_NET_BUF_RX_COUNT=64
CONFIG_NET_BUF_TX_COUNT=64
CONFIG_NET_MAX_CONTEXTS=16
CONFIG_NET_L2_ETHERNET=y
CONFIG_DNS_RESOLVER=n

# -----------------------------------------------------------------------------
# POSIX API (required by nano-ros zenoh-pico / dust-dds backends)
# -----------------------------------------------------------------------------
CONFIG_POSIX_API=y
CONFIG_MAX_PTHREAD_MUTEX_COUNT=32
CONFIG_MAX_PTHREAD_COND_COUNT=16
CONFIG_MAX_PTHREAD_COUNT=16
CONFIG_POSIX_THREAD_THREADS_MAX=16

# -----------------------------------------------------------------------------
# nros module
# -----------------------------------------------------------------------------
CONFIG_NROS=y
CONFIG_NROS_CPP_API=y
CONFIG_NROS_RMW_DDS=y
CONFIG_NROS_DOMAIN_ID=0

# -----------------------------------------------------------------------------
# Timing
# -----------------------------------------------------------------------------
CONFIG_SYS_CLOCK_TICKS_PER_SEC=1000

# -----------------------------------------------------------------------------
# Debug
# -----------------------------------------------------------------------------
CONFIG_DEBUG=y
CONFIG_DEBUG_INFO=y
CONFIG_NET_LOG=y
CONFIG_NET_STATISTICS=y
CONFIG_NET_SHELL=y
CONFIG_NET_CONNECTION_MANAGER=y
```

## boards/fvp_baser_aemv8r_smp.conf
```kconfig
# FVP Base RevC AEMv8-R SMP — Ethernet up via SMSC91C111.
# Mirrors actuation_module/boards/fvp_baser_aemv8r_smp_actuation.conf
# minus the ASI-specific DDS / CAN config.

CONFIG_MDIO=y
CONFIG_MDIO_INIT_PRIORITY=81
CONFIG_PHY_INIT_PRIORITY=82
# Out-of-order priorities work around an SMSC91C111 driver limitation.
CONFIG_ETH_INIT_PRIORITY=80
CONFIG_CHECK_INIT_PRIORITIES=n
```

## boards/fvp_baser_aemv8r_fvp_aemv8r_aarch64_smp.overlay
```dts
/*
 * Copyright (c) 2026, NEWSLab NTU.
 * SPDX-License-Identifier: Apache-2.0
 *
 * Phase 1A smoke — enable FVP ethernet + PHY + MDIO. Mirrors
 * actuation_module/boards/fvp_baser_aemv8r_smp.overlay.
 */

&eth {
	status = "okay";
};

&phy {
	status = "okay";
};

&mdio {
	status = "okay";
};
```

## src/main.cpp
```c
/*
 * Copyright (c) 2026, NEWSLab NTU.
 * SPDX-License-Identifier: Apache-2.0
 *
 * Phase 1A smoke — minimal nros-cpp Int32 publisher. Goal: prove the
 * nano-ros Zephyr module + nros-cpp API link cleanly into ASI's build
 * tree for the FVP target. Adapted from
 * nano-ros-autoware/examples/zephyr/cpp/dds/talker/src/main.cpp.
 */

#include <zephyr/kernel.h>
#include <zephyr/logging/log.h>

LOG_MODULE_REGISTER(asi_nros_smoke, LOG_LEVEL_INF);

#define NROS_TRY_LOG(file, line, expr, ret) \
    LOG_ERR("%s:%d %s -> %d", (file), (line), (expr), (int)(ret))

#include <nros/app_main.h>
#include <nros/nros.hpp>

#include "std_msgs.hpp"

int nros_app_main(int argc, char **argv) {
    (void)argc;
    (void)argv;

    LOG_INF("ASI nano-ros smoke (Phase 1A)");
    LOG_INF("==============================");

    NROS_TRY_RET(nros::init("", CONFIG_NROS_DOMAIN_ID), 1);

    nros::Node node;
    NROS_TRY_RET(nros::create_node(node, "asi_nano_ros_smoke"), 1);

    nros::Publisher<std_msgs::msg::Int32> pub;
    NROS_TRY_RET(node.create_publisher(pub, "/asi/smoke/counter"), 1);

    LOG_INF("Publishing /asi/smoke/counter ...");

    int32_t count = 0;
    while (true) {
        count++;
        std_msgs::msg::Int32 msg;
        msg.data = count;
        nros::Result ret = pub.publish(msg);
        if (ret.ok()) {
            LOG_INF("Published: %d", count);
        } else {
            LOG_ERR("Publish failed: %d", ret.raw());
        }
        k_sleep(K_SECONDS(1));
    }

    nros::shutdown();
    return 0;
}

NROS_APP_MAIN_REGISTER_ZEPHYR()
```
